/*
 * Copyright 2024, UNSW
 *
 * SPDX-License-Identifier: BSD-2-Clause
 */

/ {
    memory@40000000 {
		reg = <0x00 0x40000000 0x00 0x1400000>;
		device_type = "memory";
	};

	chosen {
		stdout-path = "/pl011@9000000";
		bootargs = "console=hvc0 earlycon=hvc0 pci=nomsi earlyprintk=serial debug loglevel=8 uio_pdrv_genirq.of_id=generic-uio";
		linux,stdout-path = "/pl011@9000000";
		linux,initrd-start = <0x40400000>;
		linux,initrd-end = <0x40600000>;
	};
};