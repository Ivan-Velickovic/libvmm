/*
 * Copyright 2024, UNSW
 *
 * SPDX-License-Identifier: BSD-2-Clause
 */
/ {
	virtio-console@0130000 {
		compatible = "virtio,mmio";
		reg = <0x00 0x130000 0x00 0x200>;
		interrupts = <0x00 42 0x04>;
	};

	uio0 {
		compatible = "generic-uio\0uio";
		reg = <
			0x00 0x79800000 0x00 0x1000
			0x00 0x80000000 0x00 0x1000
			0x00 0x80200000 0x00 0X1000
			0x00 0x80400000 0x00 0x200000
			0x00 0x80600000 0x00 0x200000
		>;
		interrupts = <0x00 18 0x04>;
		// IRQ = 50
	};

	/* Second UIO device for blk, just need this for the 2 extra regions */
	uio1 {
		compatible = "generic-uio\0uio";
		reg = <
			0x00 0x80800000 0x00 0x200000
			0x00 0x80a00000 0x00 0x200000
			0x00 0x80c00000 0x00 0x200000
			0x00 0x80e00000 0x00 0x200000
		>;
	};
};
